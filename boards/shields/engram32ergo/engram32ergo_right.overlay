#include "engram32ergo.dtsi"

/ {
    bootloader_key: bootloader_key {
        compatible = "zmk,boot-magic-key";
        key-position = <4>;
        jump-to-bootloader;
    };
};

&default_transform {
    col-offset = <7>;
};
