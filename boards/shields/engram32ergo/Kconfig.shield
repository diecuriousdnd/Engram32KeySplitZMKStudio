## boards/shields/engram32ergo/Kconfig.shield
```kconfig
config SHIELD_engram32ergo_LEFT
    def_bool $(shields_list_contains,engram32ergo_left)

config SHIELD_engram32ergo_RIGHT
    def_bool $(shields_list_contains,engram32ergo_right)
```
